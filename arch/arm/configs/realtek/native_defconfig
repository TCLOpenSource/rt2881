## drivers/rtk_kdriver/quick_show/Kconfig
```kconfig
config RTK_KDRV_QUICKSHOW
	tristate "Quick-Show driver"
    select RTK_KDRV_QUICKSHOW_STATUS
	help
	  This quick show driver is for RTK quick-show feature

	  If unsure, say N.

config RTK_KDRV_QUICKSHOW_STATUS
	tristate "Quick-Show status driver"
	help
	  This quick show driver is for RTK quick-show feature

	  If unsure, say N.
```

## drivers/rtk_kdriver/rmm/Kconfig
```kconfig
config REALTEK_MEMORY_MANAGEMENT
	tristate "Realtek memory management"
	default y
	help
		Code added for Realtek memory management

config CMA_RTK_ALLOCATOR
	bool "Use RTK blueprint"
	default y
	depends on REALTEK_MEMORY_MANAGEMENT
	help
	  Use RTK blueprint to replace bitmap allocator.

config CMA_FIRST_POLICY
	bool "Use CMA memory first"
	default n
	depends on REALTEK_MEMORY_MANAGEMENT
	help
	  Use CMA memory first if user allocate movable memory.

config REALTEK_MANAGE_OVERLAPPED_REGION
	bool "Manage the memory region overlapped by RBUS & NOR."
	default n
	depends on CMA_RTK_ALLOCATOR && REALTEK_MEMORY_MANAGEMENT
	help
		Put the memory region overlapped by RBUS & NOR under the control of linux.

config REALTEK_DEV_MEM
	tristate "Provide the /dev/rtkmem interface."
	default n
	help
		Provide an interface to replace /dev/mem.

config REALTEK_IOMMU
    tristate "realtek iommu driver"
    default n
    depends on REALTEK_MEMORY_MANAGEMENT
    select IOMMU_DMA if IOMMU_SUPPORT
    help
      The realtek iommu driver.

config REALTEK_IOMMU_CONTIG_MEMORY_HACK
    bool "realtek iommu with contiguous memory hack"
    default n
    depends on REALTEK_IOMMU
    help
      A hack of using contiguous memory on iommu driver,
      this can be used for run on non-iommu hw platform.

config REALTEK_IOMMU_VERIFY
    bool "realtek iommu verifier"
    default n
    depends on REALTEK_IOMMU
    help
      The testcase of iommu driver for HW verify.

source "drivers/rtk_kdriver/rmm/dma-buf/Kconfig"
source "drivers/rtk_kdriver/rmm/ion/Kconfig"
```

## drivers/rtk_kdriver/rtk_pwr_monitor/Kconfig
```kconfig
menu "Realtek Power monitor"

config RTK_KDRV_PWR_MONITOR
	tristate "Use Realtek Power Monitor driver"
	depends on RTK_KDRIVER_SUPPORT
	select RTK_KDRIVER
	default n
	help
		RTK POWER MONITOR
endmenu
```

## drivers/rtk_kdriver/usb_device/Kconfig
```kconfig
config RTK_KDRV_USB_DEVICE
    bool "RTK USB Device driver support"
    depends on USB
	default n
```

## drivers/rtk_kdriver/video_common/Kconfig
```kconfig
menu "VIDEO_COMMON"

config RTK_VIDEO_COMMON
	tristate "Enable video common Support"
	default n
	help
		Enable video common

config RTK_DYNAMIC_ENABLE_VIDEO_COMMON
	bool "Dynamic Enable video common dynamic"
	default n
	help
		dynamic Enable video common

endmenu
```

## drivers/rtk_kdriver/wifi/Kconfig
```kconfig
config RTL8822CU
    tristate "Realtek 8822C USB WiFi (WIFI-5)"
    depends on USB && RTK_KDRV_WIFI
    select RTLWIFI
    select RTLWIFI_USB
    help
      Help message of RTL8822CU

config RTL8822EU
    tristate "Realtek 8822E USB WiFi (WIFI-5)"
    depends on USB && RTK_KDRV_WIFI
    select RTLWIFI
    select RTLWIFI_USB
    help
      Help message of RTL8822EU

config RTL8852BU
    tristate "Realtek 8852B USB WiFi (WIFI-6)"
    depends on USB && RTK_KDRV_WIFI
    select RTLWIFI
    select RTLWIFI_USB
    help
      Help message of RTL8852BU
```
