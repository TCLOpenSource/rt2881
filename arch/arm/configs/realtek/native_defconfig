## arch/arm/configs/realtek/native_defconfig
```kconfig
# CONFIG_LOCALVERSION_AUTO is not set
CONFIG_SYSVIPC=y
CONFIG_AUDIT=y
CONFIG_NO_HZ=y
CONFIG_HIGH_RES_TIMERS=y
CONFIG_PREEMPT=y
CONFIG_BSD_PROCESS_ACCT=y
CONFIG_LOG_BUF_SHIFT=16
CONFIG_CGROUPS=y
CONFIG_CGROUP_PIDS=y
CONFIG_CGROUP_FREEZER=y
CONFIG_CPUSETS=y
CONFIG_CGROUP_CPUACCT=y
CONFIG_CC_OPTIMIZE_FOR_SIZE=y
CONFIG_KALLSYMS_ALL=y
CONFIG_EMBEDDED=y
CONFIG_PROFILING=y
CONFIG_SCHED_MC=y
CONFIG_SCHED_SMT=y
CONFIG_SECCOMP=y
CONFIG_KEXEC=y
CONFIG_COMPAT=y
CONFIG_CMDLINE="mem=256M console=ttyS0,115200 earlyprintk"
CONFIG_PM_WAKELOCKS=y
CONFIG_PM_DEBUG=y
CONFIG_CPU_FREQ=y
CONFIG_CPU_FREQ_GOV_POWERSAVE=y
CONFIG_CPU_FREQ_GOV_USERSPACE=y
CONFIG_CPU_FREQ_GOV_ONDEMAND=y
CONFIG_CPU_FREQ_GOV_CONSERVATIVE=y
CONFIG_MODULES=y
CONFIG_MODULE_FORCE_LOAD=y
CONFIG_MODULE_UNLOAD=y
CONFIG_MODULE_FORCE_UNLOAD=y
# CONFIG_BLK_DEV_BSG is not set
CONFIG_PARTITION_ADVANCED=y
CONFIG_BINFMT_MISC=y
CONFIG_CMA=y
CONFIG_CMA_DEBUGFS=y
CONFIG_ZSMALLOC=y
CONFIG_NET=y
CONFIG_PACKET=y
CONFIG_UNIX=y
CONFIG_UNIX_DIAG=y
CONFIG_XFRM_USER=y
CONFIG_NET_KEY=y
CONFIG_INET=y
CONFIG_IP_MULTICAST=y
CONFIG_IP_ADVANCED_ROUTER=y
CONFIG_IP_FIB_TRIE_STATS=y
CONFIG_IP_MULTIPLE_TABLES=y
CONFIG_IP_ROUTE_MULTIPATH=y
CONFIG_IP_PNP=y
CONFIG_INET_AH=y
CONFIG_INET_ESP=y
CONFIG_INET_IPCOMP=y
CONFIG_IPV6_ROUTER_PREF=y
CONFIG_IPV6_ROUTE_INFO=y
CONFIG_IPV6_OPTIMISTIC_DAD=y
CONFIG_INET6_AH=y
CONFIG_INET6_ESP=y
CONFIG_INET6_IPCOMP=y
CONFIG_IPV6_MIP6=y
CONFIG_IPV6_MULTIPLE_TABLES=y
CONFIG_IPV6_SUBTREES=y
CONFIG_NETLABEL=y
CONFIG_NETFILTER=y
CONFIG_BRIDGE_NETFILTER=y
CONFIG_NF_CONNTRACK=y
CONFIG_NF_CONNTRACK_EVENTS=y
CONFIG_NF_CONNTRACK_TIMEOUT=y
CONFIG_NF_CONNTRACK_AMANDA=y
CONFIG_NF_CONNTRACK_FTP=y
CONFIG_NF_CONNTRACK_H323=y
CONFIG_NF_CONNTRACK_IRC=y
CONFIG_NF_CONNTRACK_NETBIOS_NS=y
CONFIG_NF_CONNTRACK_PPTP=y
CONFIG_NF_CONNTRACK_SANE=y
CONFIG_NF_CONNTRACK_TFTP=y
CONFIG_NF_CT_NETLINK=y
CONFIG_NF_TABLES=y
CONFIG_NF_TABLES_INET=y
CONFIG_NFT_NAT=y
CONFIG_NETFILTER_XT_TARGET_AUDIT=y
CONFIG_NETFILTER_XT_TARGET_CHECKSUM=y
CONFIG_NETFILTER_XT_TARGET_CLASSIFY=y
CONFIG_NETFILTER_XT_TARGET_CONNMARK=y
CONFIG_NETFILTER_XT_TARGET_CT=y
CONFIG_NETFILTER_XT_TARGET_DSCP=y
CONFIG_NETFILTER_XT_TARGET_HL=y
CONFIG_NETFILTER_XT_TARGET_HMARK=y
CONFIG_NETFILTER_XT_TARGET_IDLETIMER=y
CONFIG_NETFILTER_XT_TARGET_LOG=y
CONFIG_NETFILTER_XT_TARGET_MARK=y
CONFIG_NETFILTER_XT_TARGET_NETMAP=y
CONFIG_NETFILTER_XT_TARGET_NFLOG=y
CONFIG_NETFILTER_XT_TARGET_NFQUEUE=y
CONFIG_NETFILTER_XT_TARGET_REDIRECT=y
CONFIG_NETFILTER_XT_TARGET_TEE=y
CONFIG_NETFILTER_XT_TARGET_TPROXY=y
CONFIG_NETFILTER_XT_TARGET_TRACE=y
CONFIG_NETFILTER_XT_TARGET_TCPMSS=y
CONFIG_NETFILTER_XT_TARGET_TCPOPTSTRIP=y
CONFIG_NETFILTER_XT_MATCH_ADDRTYPE=y
CONFIG_NETFILTER_XT_MATCH_CLUSTER=y
CONFIG_NETFILTER_XT_MATCH_COMMENT=y
CONFIG_NETFILTER_XT_MATCH_CONNBYTES=y
CONFIG_NETFILTER_XT_MATCH_CONNLIMIT=y
CONFIG_NETFILTER_XT_MATCH_CONNMARK=y
CONFIG_NETFILTER_XT_MATCH_CONNTRACK=y
CONFIG_NETFILTER_XT_MATCH_CPU=y
CONFIG_NETFILTER_XT_MATCH_DCCP=y
CONFIG_NETFILTER_XT_MATCH_DEVGROUP=y
CONFIG_NETFILTER_XT_MATCH_DSCP=y
CONFIG_NETFILTER_XT_MATCH_ESP=y
CONFIG_NETFILTER_XT_MATCH_HASHLIMIT=y
CONFIG_NETFILTER_XT_MATCH_HELPER=y
CONFIG_NETFILTER_XT_MATCH_IPCOMP=y
CONFIG_NETFILTER_XT_MATCH_IPRANGE=y
CONFIG_NETFILTER_XT_MATCH_L2TP=y
CONFIG_NETFILTER_XT_MATCH_LENGTH=y
CONFIG_NETFILTER_XT_MATCH_LIMIT=y
CONFIG_NETFILTER_XT_MATCH_MAC=y
CONFIG_NETFILTER_XT_MATCH_MARK=y
CONFIG_NETFILTER_XT_MATCH_MULTIPORT=y
CONFIG_NETFILTER_XT_MATCH_NFACCT=y
CONFIG_NETFILTER_XT_MATCH_OSF=y
CONFIG_NETFILTER_XT_MATCH_POLICY=y
CONFIG_NETFILTER_XT_MATCH_PHYSDEV=y
CONFIG_NETFILTER_XT_MATCH_PKTTYPE=y
CONFIG_NETFILTER_XT_MATCH_QUOTA=y
CONFIG_NETFILTER_XT_MATCH_RATEEST=y
CONFIG_NETFILTER_XT_MATCH_REALM=y
CONFIG_NETFILTER_XT_MATCH_RECENT=y
CONFIG_NETFILTER_XT_MATCH_SCTP=y
CONFIG_NETFILTER_XT_MATCH_STATE=y
CONFIG_NETFILTER_XT_MATCH_STATISTIC=y
CONFIG_NETFILTER_XT_MATCH_STRING=y
CONFIG_NETFILTER_XT_MATCH_TCPMSS=y
CONFIG_NETFILTER_XT_MATCH_TIME=y
CONFIG_NETFILTER_XT_MATCH_U32=y
CONFIG_IP_NF_IPTABLES=y
CONFIG_IP_NF_MATCH_AH=y
CONFIG_IP_NF_MATCH_ECN=y
CONFIG_IP_NF_MATCH_TTL=y
CONFIG_IP_NF_FILTER=y
CONFIG_IP_NF_TARGET_REJECT=y
CONFIG_IP_NF_MANGLE=y
CONFIG_IP_NF_RAW=y
CONFIG_IP_NF_SECURITY=y
CONFIG_IP_NF_ARPTABLES=y
CONFIG_IP_NF_ARPFILTER=y
CONFIG_IP_NF_ARP_MANGLE=y
CONFIG_IP6_NF_IPTABLES=y
CONFIG_IP6_NF_FILTER=y
CONFIG_IP6_NF_TARGET_REJECT=y
CONFIG_IP6_NF_MANGLE=y
CONFIG_IP6_NF_RAW=y
CONFIG_IP6_NF_SECURITY=y
CONFIG_IP6_NF_NAT=y
CONFIG_BRIDGE_NF_EBTABLES=y
CONFIG_BRIDGE_EBT_BROUTE=y
CONFIG_BRIDGE_EBT_T_FILTER=y
CONFIG_BRIDGE_EBT_T_NAT=y
CONFIG_BRIDGE_EBT_802_3=y
CONFIG_BRIDGE_EBT_AMONG=y
CONFIG_BRIDGE_EBT_ARP=y
CONFIG_BRIDGE_EBT_IP=y
CONFIG_BRIDGE_EBT_IP6=y
CONFIG_BRIDGE_EBT_LIMIT=y
CONFIG_BRIDGE_EBT_MARK=y
CONFIG_BRIDGE_EBT_PKTTYPE=y
CONFIG_BRIDGE_EBT_STP=y
CONFIG_BRIDGE_EBT_VLAN=y
CONFIG_BRIDGE_EBT_ARPREPLY=y
CONFIG_BRIDGE_EBT_DNAT=y
CONFIG_BRIDGE_EBT_MARK_T=y
CONFIG_BRIDGE_EBT_REDIRECT=y
CONFIG_BRIDGE_EBT_SNAT=y
CONFIG_BRIDGE_EBT_LOG=y
CONFIG_BRIDGE_EBT_NFLOG=y
CONFIG_BRIDGE=y
CONFIG_NET_SCHED=y
CONFIG_NET_SCH_HTB=y
CONFIG_NET_CLS_U32=y
CONFIG_NET_EMATCH=y
CONFIG_NET_EMATCH_U32=y
CONFIG_NET_CLS_ACT=y
CONFIG_NETLINK_DIAG=y
CONFIG_CFG80211=y
CONFIG_NL80211_TESTMODE=y
CONFIG_CFG80211_DEVELOPER_WARNINGS=y
CONFIG_CFG80211_CERTIFICATION_ONUS=y
# CONFIG_CFG80211_DEFAULT_PS is not set
CONFIG_CFG80211_WEXT=y
CONFIG_MAC80211=y
CONFIG_MAC80211_MESH=y
CONFIG_MAC80211_MESSAGE_TRACING=y
CONFIG_MAC80211_DEBUG_MENU=y
CONFIG_DEVTMPFS=y
CONFIG_DEVTMPFS_MOUNT=y
CONFIG_MTD=y
CONFIG_MTD_CMDLINE_PARTS=y
CONFIG_MTD_BLOCK=y
CONFIG_MTD_OOPS=y
CONFIG_ZRAM=y
CONFIG_BLK_DEV_LOOP=y
CONFIG_BLK_DEV_CRYPTOLOOP=y
CONFIG_BLK_DEV_RAM=y
CONFIG_BLK_DEV_RAM_SIZE=16384
CONFIG_SCSI=y
# CONFIG_SCSI_PROC_FS is not set
CONFIG_BLK_DEV_SD=y
CONFIG_CHR_DEV_SG=y
CONFIG_SCSI_SCAN_ASYNC=y
CONFIG_MD=y
CONFIG_BLK_DEV_DM=y
CONFIG_DM_CRYPT=y
CONFIG_DM_VERITY=y
CONFIG_NETDEVICES=y
CONFIG_TUN=y
# CONFIG_NET_VENDOR_BROADCOM is not set
# CONFIG_NET_VENDOR_INTEL is not set
# CONFIG_NET_VENDOR_MARVELL is not set
# CONFIG_NET_VENDOR_MICREL is not set
# CONFIG_NET_VENDOR_NATSEMI is not set
CONFIG_ETHOC=y
# CONFIG_NET_VENDOR_SMSC is not set
# CONFIG_NET_VENDOR_STMICRO is not set
# CONFIG_NET_VENDOR_WIZNET is not set
CONFIG_PPP=y
CONFIG_PPP_BSDCOMP=y
CONFIG_PPP_DEFLATE=y
CONFIG_PPP_MPPE=y
CONFIG_USB_RTL8152=y
CONFIG_USB_USBNET=y
# CONFIG_WLAN_VENDOR_ADMTEK is not set
# CONFIG_WLAN_VENDOR_ATH is not set
# CONFIG_WLAN_VENDOR_ATMEL is not set
# CONFIG_WLAN_VENDOR_BROADCOM is not set
# CONFIG_WLAN_VENDOR_CISCO is not set
# CONFIG_WLAN_VENDOR_INTEL is not set
# CONFIG_WLAN_VENDOR_INTERSIL is not set
# CONFIG_WLAN_VENDOR_MARVELL is not set
# CONFIG_WLAN_VENDOR_MEDIATEK is not set
# CONFIG_WLAN_VENDOR_RALINK is not set
CONFIG_RTL8822CU=m
CONFIG_RTL8852AU=m
CONFIG_RTL8188GTVU=m
# CONFIG_RTLWIFI_DEBUG is not set
CONFIG_INPUT_JOYDEV=y
CONFIG_INPUT_EVDEV=y
# CONFIG_INPUT_MOUSE is not set
CONFIG_INPUT_MISC=y
CONFIG_INPUT_UINPUT=y
# CONFIG_VT is not set
CONFIG_HW_RANDOM=y
CONFIG_TCG_TPM=y
# CONFIG_I2C_COMPAT is not set
# CONFIG_I2C_HELPER_AUTO is not set
# CONFIG_HWMON is not set
CONFIG_THERMAL=y
CONFIG_CPU_THERMAL=y
CONFIG_REGULATOR=y
CONFIG_MEDIA_SUPPORT=y
CONFIG_MEDIA_CAMERA_SUPPORT=y
CONFIG_MEDIA_USB_SUPPORT=y
CONFIG_USB_VIDEO_CLASS=y
CONFIG_V4L_PLATFORM_DRIVERS=y
CONFIG_DRM=y
CONFIG_FB_FOREIGN_ENDIAN=y
CONFIG_FB_MODE_HELPERS=y
CONFIG_FB_TILEBLITTING=y
CONFIG_SOUND=y
CONFIG_SND=y
CONFIG_SND_OSSEMUL=y
CONFIG_SND_MIXER_OSS=y
CONFIG_SND_PCM_OSS=y
CONFIG_HIDRAW=y
CONFIG_USB=y
CONFIG_USB_XHCI_HCD=y
CONFIG_USB_EHCI_HCD=y
CONFIG_USB_OHCI_HCD=y
CONFIG_USB_HCD_TEST_MODE=y
CONFIG_USB_STORAGE=y
CONFIG_MMC=y
CONFIG_MMC_BLOCK_MINORS=16
CONFIG_RTC_CLASS=y
CONFIG_DMABUF_HEAPS=y
CONFIG_DMABUF_HEAPS_SYSTEM=y
CONFIG_DMABUF_HEAPS_CMA=y
CONFIG_DMABUF_HEAPS_CHUNK=y
CONFIG_DMABUF_HEAPS_DVR=y
CONFIG_DMABUF_CARVEOUT_HEAP=y
CONFIG_DMABUF_HEAPS_VBM=y
CONFIG_STAGING=y
CONFIG_MAILBOX=y
CONFIG_TEE=y
CONFIG_OPTEE=y
CONFIG_OPTEE_SECURE_SVP_PROTECTION=y
CONFIG_OPTEE_SUPPORT_VERSION_3_X=y
CONFIG_EXT2_FS=y
CONFIG_EXT4_FS=y
CONFIG_EXT4_FS_POSIX_ACL=y
CONFIG_EXT4_FS_SECURITY=y
CONFIG_FUSE_FS=y
CONFIG_MSDOS_FS=y
CONFIG_VFAT_FS=y
CONFIG_NTFS_FS=y
CONFIG_NTFS_RW=y
CONFIG_SQUASHFS=y
CONFIG_SQUASHFS_XATTR=y
CONFIG_SQUASHFS_LZO=y
CONFIG_SQUASHFS_XZ=y
CONFIG_SQUASHFS_4K_DEVBLK_SIZE=y
CONFIG_SQUASHFS_EMBEDDED=y
CONFIG_NFS_FS=y
CONFIG_NFS_V4=y
CONFIG_CIFS=y
# CONFIG_CIFS_DEBUG is not set
CONFIG_NLS_CODEPAGE_437=y
CONFIG_NLS_ISO8859_1=y
CONFIG_NLS_UTF8=y
CONFIG_SECURITY=y
CONFIG_SECURITY_NETWORK=y
CONFIG_CRYPTO_MICHAEL_MIC=y
CONFIG_CRC_T10DIF=y
CONFIG_CRC_ITU_T=y
CONFIG_CRC7=y
CONFIG_DMA_CMA=y
CONFIG_PRINTK_TIME=y
CONFIG_DYNAMIC_DEBUG=y
CONFIG_DEBUG_INFO=y
CONFIG_MAGIC_SYSRQ=y
CONFIG_PAGE_OWNER=y
CONFIG_SCHEDSTATS=y
# CONFIG_DEBUG_PREEMPT is not set
CONFIG_DEBUG_MUTEXES=y
CONFIG_SCHED_TRACER=y
CONFIG_SERIAL_EARLYCON=y
CONFIG_SWAP=y
# CONFIG_STRICT_DEVMEM is not set
# CONFIG_EARLY_PRINTK is not set
CONFIG_USB_CONFIGFS=y
```

## arch/arm64/configs/realtek/disable_lto_defconfig
```kconfig
# CONFIG_LTO is not set
# CONFIG_LTO_CLANG is not set
# CONFIG_LTO_CLANG_FULL is not set
# CONFIG_LTO_CLANG_THIN is not set
```

## arch/arm64/configs/realtek/fragment.android.14.rtd2875q_dv.tv001_defconfig
```kconfig
CONFIG_ARCH_RTK2875Q=y
CONFIG_REALTEK_SECURE=y
CONFIG_REALTEK_DEV_MEM=y
CONFIG_REALTEK_PCBMGR=y
CONFIG_REALTEK_MANAGE_OVERLAPPED_REGION=y
CONFIG_USE_SHARE_COMMON=y
CONFIG_RTK_MEASURE=y
CONFIG_RTK_HDCP_OPTEE=y
CONFIG_OPTEE_HDCP2=y
CONFIG_OPTEE_HDCP14=y
CONFIG_ENABLE_DOLBY_VISION_HDMI_AUTO_DETECT=y
CONFIG_ENABLE_DOLBY_VISION_VSEM=y
CONFIG_ENABLE_HDR10_HDMI_AUTO_DETECT=y
CONFIG_HDMI_DRV_HPD=y
# CONFIG_REALTEK_VOLTAGE_CTRL is not set
CONFIG_RTK_KDRV_AMP=y
CONFIG_RTK_KDRV_AVCPU=y
CONFIG_RTK_KDRV_SUPPORT_VCPU2=y
CONFIG_REALTEK_LOGBUF=y
# CONFIG_REALTEK_EVENT_LOG is not set
# CONFIG_RTK_USBDUMP_ENABLE is not set
CONFIG_RTK_DRV_DDR_SCAN=y
CONFIG_RTK_KDRV_SB2=y
CONFIG_RTK_KDRV_DC_MEMORY_TRASH_DETCTER=y
CONFIG_REALTEK_ARM_WRAPPER=y
CONFIG_RTK_KDRV_GPIO_IGNORE_ADMIN_CHECK=y
CONFIG_RTK_KDRV_PWM=y
CONFIG_RTK_KDRV_I2C_ALGO_RTK=y
CONFIG_RTK_KDRV_I2C=y
# CONFIG_RTK_KDRV_I2C_BUS_JAM_RECOVER is not set
CONFIG_RTK_KDRV_PCMCIA=y
CONFIG_RTK_KDRV_CIPLUS_USB=y
CONFIG_RTK_KDRV_DELIVERY=y
CONFIG_RTK_KDRV_LNB_UART=y
CONFIG_RTK_KDRV_PINMUX=y
CONFIG_RTK_KDRV_MISC_DEV=y
CONFIG_RTK_KDRV_SMARTCARD=y
CONFIG_RTK_KDRV_SMARTCARD_CHARDEV=y
CONFIG_RTK_KDRV_SMARTCARD_DEV_FILE=y
# CONFIG_RTK_KDRV_SMARTCARD_DEBUG is not set
CONFIG_RTK_KDRV_SMARTCARD_IFD=y
CONFIG_RTK_KDRV_CEC=y
CONFIG_RTK_KDRV_EXTCON=y
CONFIG_RTK_KDRV_OTP=y
CONFIG_RTK_KDRV_RNG=y
CONFIG_RTK_KDRV_MCP=y
CONFIG_RTK_KDRV_MCP_NAPI=y
CONFIG_RTK_KDRV_MCP_SHA256=y
CONFIG_RTK_KDRV_MCP_RSA=y
CONFIG_RTK_KDRV_DV=y
CONFIG_DOLBY_IDK_1_6_1_1=y
CONFIG_SUPPORT_DOLBY_VSIF=y
CONFIG_RTK_KDRV_MD=y
CONFIG_RTK_KDRV_RTC=y
CONFIG_RTK_KDRV_THERMAL=y
CONFIG_RTK_KDRV_DYNAMIC_REFRESH_SETTING=y
CONFIG_RTK_KDRV_THERMAL_GOV_RTK_THERMAL_THROTTLE=y
CONFIG_RTK_KDRV_THERMAL_DEFAULT_GOV_RTK_THERMAL=y
CONFIG_RTK_KDRV_THERMAL_SENSOR=y
CONFIG_RTK_POWER=m
CONFIG_RTK_KDRV_QOS_CONTROL=y
CONFIG_RTK_KDRV_DYNAMIC_INPUT_DEV_NAME=y
CONFIG_RTK_KDRV_RAW_MODE=y
CONFIG_RTK_KDRV_MK5_2=y
CONFIG_RTK_KDRV_TV002_IR_RAW_MODE=y
CONFIG_RTK_KDRV_TV036_10D_IR=y
CONFIG_RTK_KDRV_DEMOD=y
CONFIG_RTK_KDRV_DEMOD_TEST=y
CONFIG_RTK_KDRV_TP=y
CONFIG_RTK_KDRV_DEMUX=y
CONFIG_RTK_KDRV_DELIVERY=y
CONFIG_RTK_KDRV_JP4K=y
CONFIG_RTK_KDRV_AUDIO=y
CONFIG_SND_KDRV_REALTEK=y
CONFIG_RTK_KDRV_VDEC=y
CONFIG_RTK_KDRV_AUDIO_HW=y
CONFIG_RTK_KDRV_CRM=y
CONFIG_RTK_KDRV_OMX=y
CONFIG_RTK_KDRV_SE=y
CONFIG_RTK_KDRV_GDMA=y
CONFIG_RTK_KDRV_REFDECMP=y
CONFIG_RTK_KDRV_SERIAL_8250=y
CONFIG_RTK_KDRV_SERIAL_8250_EXTENDED=y
CONFIG_RTK_KDRV_SERIAL_8250_CONSOLE=y
CONFIG_RTK_KDRV_SERIAL_8250_NR_UARTS=32
CONFIG_RTK_KDRV_SERIAL_8250_RUNTIME_UARTS=2
CONFIG_RTK_KDRV_SERIAL_8250_MANY_PORTS=y
CONFIG_RTK_KDRV_SERIAL_8250_SHARE_IRQ=y
CONFIG_RTK_KDRV_SERIAL_8250_DETECT_IRQ=y
CONFIG_RTK_KDRV_SERIAL_8250_RSA=y
CONFIG_RTK_KDRV_SERIAL_8250_UART_DMA=y
CONFIG_RTK_AI_DRV=y
# CONFIG_RTK_KDRV_VAD is not set
# CONFIG_RTK_KDRV_SVAD is not set
CONFIG_CRYPTO_RTK_LZMA=y
CONFIG_RTK_KDRV_SERIAL_LED=y
CONFIG_RTK_KDRV_GPIO_LED=y

CONFIG_NEW_LEDS=y
CONFIG_LEDS_CLASS=y
CONFIG_LEDS_TRIGGERS=y
CONFIG_RTK_LEDS_GPIO=y
CONFIG_RTK_KDRV_LEDS=y
# emmc
CONFIG_MMC_RTKEMMC_PLUS=y
CONFIG_RTKEMMC_HS200=y
CONFIG_RTKEMMC_HS400=y
CONFIG_RTKEMMC_HS200_CLOCK=200
CONFIG_MMC_RTKEMMC_SHOW_EXTCSD=y
CONFIG_MMC_RTKEMMC_HK_ATTR=y
CONFIG_MMC_RTKEMMC_VENDOR_IOCTL=y

# usb
CONFIG_RTK_KDRV_USB=y
CONFIG_RTK_KDRV_USB_CORE=y
CONFIG_RTK_KDRV_EHCI_HCD_PLATFORM=y
CONFIG_USB_OHCI_HCD=y
CONFIG_RTK_KDRV_OHCI_HCD_PLATFORM=y
CONFIG_RTK_KDRV_USB_OTG_PLATFORM=y
CONFIG_USB_DWC2_PERIPHERAL=y
#CONFIG_USB_DWC2_DUAL_ROLE is not set

# wifi
CONFIG_CFG80211=y
CONFIG_NL80211_TESTMODE=y
# CONFIG_CFG80211_DEFAULT_PS is not set
# CONFIG_CFG80211_CRDA_SUPPORT is not set
CONFIG_MAC80211=y
CONFIG_RTK_KDRV_WIFI=y
CONFIG_RTL8822CU=m

# module
CONFIG_BT_MT7668=m
CONFIG_BT_RTKBTUSB=m
CONFIG_RTL8188GTVU=m
CONFIG_NTFS3_FS=m

#MM
CONFIG_ZRAM=y
CONFIG_ZSMALLOC=y
CONFIG_DMABUF_CARVEOUT_HEAP=y
CONFIG_DMABUF_HEAPS_CMA=y
CONFIG_DMABUF_HEAPS_DVR=y
CONFIG_DMABUF_HEAPS_SYSTEM=y
CONFIG_DMABUF_HEAPS_VBM=y
CONFIG_VBM_CARVEOUT=y
CONFIG_VBM_CMA=y
CONFIG_VBM_HEAP=y
CONFIG_FAKEMEMORY_GRAPHICS=y

##OPTEE
CONFIG_TEE=y
CONFIG_OPTEE=y
CONFIG_OPTEE_SECURE_SVP_PROTECTION=y

# CONFIG_REALTEK_SCHED_LOG is not set
# CONFIG_DRM_FBDEV_EMULATION is not set
CONFIG_DRM_REALTEK=y

# CONFIG_RTK_FEATURE_FOR_GKI is not set

##hack: FIXME need to remove later
# CONFIG_LTO_CLANG_FULL is not set
CONFIG_LTO_CLANG_THIN=y
# CONFIG_SERIAL_8250 is not set
# CONFIG_MODULE_SIG_ALL is not set

# CONFIG_UNWIND_PATCH_PAC_INTO_SCS is not set
```
