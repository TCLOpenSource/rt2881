## arch/arm64/configs/realtek/fragment.module.android.14.rtd6748_dv.tv001_defconfig
```kconfig
CONFIG_ARCH_RTK6748=y
CONFIG_REALTEK_SECURE=y
CONFIG_REALTEK_DEV_MEM=m
CONFIG_REALTEK_PCBMGR=m
CONFIG_REALTEK_MANAGE_OVERLAPPED_REGION=y
CONFIG_USE_SHARE_COMMON=y
CONFIG_OPTEE_HDCP2=y
CONFIG_OPTEE_HDCP14=y
CONFIG_ENABLE_DOLBY_VISION_HDMI_AUTO_DETECT=y
CONFIG_ENABLE_DOLBY_VISION_VSEM=y
CONFIG_ENABLE_HDR10_HDMI_AUTO_DETECT=y
CONFIG_HDMI_DRV_HPD=y
CONFIG_REALTEK_VOLTAGE_CTRL=y
CONFIG_RTK_KDRV_AMP=m
CONFIG_RTK_KDRV_AVCPU=m
CONFIG_RTK_KDRV_SUPPORT_VCPU2=y
CONFIG_REALTEK_LOGBUF=m
# CONFIG_REALTEK_EVENT_LOG is not set
# CONFIG_RTK_USBDUMP_ENABLE is not set
CONFIG_RTK_DRV_DDR_SCAN=m
CONFIG_RTK_KDRV_SB2=m
CONFIG_RTK_KDRV_DC_MEMORY_TRASH_DETCTER=m
CONFIG_REALTEK_ARM_WRAPPER=m
CONFIG_RTK_KDRV_GPIO_IGNORE_ADMIN_CHECK=y
CONFIG_RTK_KDRV_PWM=m
CONFIG_RTK_KDRV_I2C_ALGO_RTK=m
CONFIG_RTK_KDRV_I2C=m
# CONFIG_RTK_KDRV_I2C_BUS_JAM_RECOVER is not set
CONFIG_RTK_KDRV_PCMCIA=m
CONFIG_RTK_KDRV_CIPLUS_USB=m
CONFIG_RTK_KDRV_DELIVERY=m
CONFIG_RTK_KDRV_LNB_UART=y
CONFIG_RTK_KDRV_PINMUX=m
CONFIG_RTK_KDRV_MISC_DEV=m
CONFIG_RTK_KDRV_SMARTCARD=m
CONFIG_RTK_KDRV_SMARTCARD_CHARDEV=y
CONFIG_RTK_KDRV_SMARTCARD_DEV_FILE=y
# CONFIG_RTK_KDRV_SMARTCARD_DEBUG is not set
CONFIG_RTK_KDRV_SMARTCARD_IFD=y
CONFIG_RTK_KDRV_CEC=m
CONFIG_RTK_KDRV_EXTCON=m
CONFIG_RTK_KDRV_OTP=m
CONFIG_RTK_KDRV_RNG=m
CONFIG_RTK_KDRV_MCP=m
CONFIG_RTK_KDRV_MCP_NAPI=y
CONFIG_RTK_KDRV_MCP_SHA256=y
CONFIG_RTK_KDRV_MCP_RSA=y
CONFIG_RTK_KDRV_DV=y
CONFIG_DOLBY_IDK_1_6_1_1=y
CONFIG_SUPPORT_DOLBY_VSIF=y
CONFIG_RTK_KDRV_MD=m
CONFIG_RTK_KDRV_RTC=m
CONFIG_RTK_KDRV_THERMAL=m
CONFIG_RTK_KDRV_DYNAMIC_REFRESH_SETTING=y
CONFIG_RTK_KDRV_THERMAL_GOV_RTK_THERMAL_THROTTLE=m
CONFIG_RTK_KDRV_THERMAL_DEFAULT_GOV_RTK_THERMAL=m
CONFIG_RTK_KDRV_THERMAL_SENSOR=m
CONFIG_RTK_POWER=m
CONFIG_RTK_KDRV_QOS_CONTROL=m
CONFIG_RTK_KDRV_DYNAMIC_INPUT_DEV_NAME=y
CONFIG_RTK_KDRV_RAW_MODE=y
CONFIG_RTK_KDRV_MK5_2=y
CONFIG_RTK_KDRV_TV002_IR_RAW_MODE=y
CONFIG_RTK_KDRV_TV036_10D_IR=y
CONFIG_RTK_KDRV_DEMOD=m
CONFIG_RTK_KDRV_DEMOD_TEST=m
CONFIG_RTK_KDRV_TP=m
CONFIG_RTK_KDRV_DEMUX=m
CONFIG_RTK_KDRV_DELIVERY=m
CONFIG_RTK_KDRV_JP4K=m
CONFIG_RTK_KDRV_AUDIO=m
CONFIG_SND_KDRV_REALTEK=m
CONFIG_RTK_KDRV_VDEC=m
CONFIG_RTK_KDRV_AUDIO_HW=m
CONFIG_RTK_KDRV_CRM=m
CONFIG_RTK_KDRV_OMX=m
CONFIG_RTK_KDRV_SE=m
CONFIG_RTK_KDRV_GDMA=m
CONFIG_RTK_KDRV_REFDECMP=m
CONFIG_RTK_KDRV_SERIAL_8250=m
CONFIG_RTK_KDRV_SERIAL_8250_EXTENDED=y
CONFIG_RTK_KDRV_SERIAL_8250_CONSOLE=y
CONFIG_RTK_KDRV_SERIAL_8250_NR_UARTS=32
CONFIG_RTK_KDRV_SERIAL_8250_RUNTIME_UARTS=2
CONFIG_RTK_KDRV_SERIAL_8250_MANY_PORTS=y
CONFIG_RTK_KDRV_SERIAL_8250_SHARE_IRQ=y
CONFIG_RTK_KDRV_SERIAL_8250_DETECT_IRQ=y
CONFIG_RTK_KDRV_SERIAL_8250_RSA=y
CONFIG_RTK_KDRV_SERIAL_8250_UART_DMA=y
CONFIG_RTK_KDRV_SERIAL_8250_DRV_NAME="ttyRTK"
CONFIG_RTK_AI_DRV=m
CONFIG_RTK_AI_SCHED=m
# CONFIG_RTK_KDRV_VAD is not set
# CONFIG_RTK_KDRV_SVAD is not set
CONFIG_CRYPTO_RTK_LZMA=m
CONFIG_RTK_KDRV_SERIAL_LED=m
CONFIG_RTK_KDRV_GPIO_LED=y

CONFIG_NEW_LEDS=m
CONFIG_LEDS_CLASS=m
CONFIG_LEDS_TRIGGERS=m
CONFIG_RTK_LEDS_GPIO=m
CONFIG_RTK_KDRV_LEDS=m

# emmc
CONFIG_MMC_RTKEMMC_PLUS=m
CONFIG_RTKEMMC_HS200=y
CONFIG_RTKEMMC_HS400=y
CONFIG_RTKEMMC_HS200_CLOCK=200
CONFIG_MMC_RTKEMMC_SHOW_EXTCSD=y
CONFIG_MMC_RTKEMMC_HK_ATTR=y
CONFIG_MMC_RTKEMMC_VENDOR_IOCTL=y

# usb
CONFIG_RTK_KDRV_USB=m
CONFIG_RTK_KDRV_USB_CORE=m
CONFIG_RTK_KDRV_XHCI_HCD_PLATFORM=m
CONFIG_RTK_KDRV_EHCI_HCD_PLATFORM=m
CONFIG_USB_OHCI_HCD=m
CONFIG_RTK_KDRV_OHCI_HCD_PLATFORM=m
CONFIG_RTK_KDRV_USB_OTG_PLATFORM=m
CONFIG_USB_DWC2_PERIPHERAL=y
#CONFIG_USB_DWC2_DUAL_ROLE is not set

# wifi
CONFIG_CFG80211=m
CONFIG_NL80211_TESTMODE=y
# CONFIG_CFG80211_DEFAULT_PS is not set
# CONFIG_CFG80211_CRDA_SUPPORT is not set
CONFIG_MAC80211=m
CONFIG_RTK_KDRV_WIFI=y
CONFIG_RTL8822CU=m

# module
CONFIG_BT_MT7668=m
CONFIG_BT_RTKBTUSB=m
CONFIG_RTL8188GTVU=m
CONFIG_NTFS3_FS=m

#MM
CONFIG_DMABUF_HEAPS_CMA=m
CONFIG_DMABUF_HEAPS_SYSTEM=m
CONFIG_REALTEK_MEMORY_MANAGEMENT=m
CONFIG_DMABUF_CARVEOUT_HEAP=m
CONFIG_DMABUF_HEAPS_DVR=m
CONFIG_DMABUF_HEAPS_VBM=m
CONFIG_VBM_CARVEOUT=y
CONFIG_VBM_CMA=y
CONFIG_VBM_HEAP=y
CONFIG_FAKEMEMORY_GRAPHICS=y

##OPTEE
CONFIG_TEE=m
CONFIG_OPTEE=m
CONFIG_OPTEE_SECURE_SVP_PROTECTION=y

##default y case n need to set to module
CONFIG_RTK_KDRV_CPU_FREQUENCY=m
CONFIG_RTK_KDRV_RTICE=m
CONFIG_RTK_KDRV_IR=m
CONFIG_RTK_KDRV_CRT=m
CONFIG_SUPPORT_SCALER=m
CONFIG_RTK_SEMAPHORE=m
CONFIG_RTK_KDRV_COMMON=m
CONFIG_RTK_KDRV_SYSFS=m
CONFIG_RTK_KDRV_RPC=m
CONFIG_RTK_KDRV_EMCU=m
CONFIG_RTK_KDRV_HW_MONITOR=m
CONFIG_RTK_KDRV_GPIO=m
CONFIG_RTK_KDRV_R8168=m
CONFIG_RTK_KDRV_DDC=m
CONFIG_RTK_KDRV_LSADC=m
CONFIG_RTK_KDRV_KEYPAD=m
CONFIG_RTK_KDRV_WATCHDOG=m
CONFIG_RTK_HDMI_RX=m
CONFIG_RTK_KDRV_SPI=m
CONFIG_RTK_ONLINE_HELP=m
CONFIG_CRYPTO_RTK_LZMA=m
# CONFIG_REALTEK_SCHED_LOG is not set
# CONFIG_DRM_FBDEV_EMULATION is not set
CONFIG_DRM_REALTEK=m

# CONFIG_RTK_FEATURE_FOR_GKI is not set
# CONFIG_MODULE_SIG_ALL is not set

CONFIG_RTK_WOV=m
```
